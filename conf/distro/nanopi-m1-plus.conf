## conf/distro/nanopi-m1-plus.conf
```bitbake
require conf/distro/poky.conf

DISTRO = "nanopi-m1-plus"
DISTRO_NAME = "nanopi M1 Plus"

DISTRO_VERSION = "18.0.0"

DISTROOVERRIDES = "nanopi-m1-plus"

DISTRO_FEATURES_append = " systemd opengl"

VIRTUAL-RUNTIME_init_manager = "systemd"

DISTRO_FEATURES_BACKFILL_CONSIDERED = "sysvinit"

VIRTUAL-RUNTIME_initscripts = ""
```

## conf/distro/nanopi-neo-m1-plus.conf
```bitbake
require conf/distro/poky.conf

DISTRO = "nanopi-neo-m1-plus"
DISTRO_NAME = "nanopi NEO M1 Plus"

DISTRO_VERSION = "18.0.0"

DISTROOVERRIDES = "nanopi-neo-m1-plus"

DISTRO_FEATURES_append = " systemd x11 opengl"

VIRTUAL-RUNTIME_init_manager = "systemd"

DISTRO_FEATURES_BACKFILL_CONSIDERED = "sysvinit"

VIRTUAL-RUNTIME_initscripts = ""
```

## conf/distro/nanopi-neo.conf
```bitbake
require conf/distro/poky.conf

DISTRO = "nanopi-neo"
DISTRO_NAME = "nanopi NEO v1.2"

DISTRO_VERSION = "17.07.16"

DISTROOVERRIDES = "nanopi-neo"

DISTRO_FEATURES_remove = " x11 wayland opengl"

DISTRO_FEATURES_append = " systemd"

VIRTUAL-RUNTIME_init_manager = "systemd"

DISTRO_FEATURES_BACKFILL_CONSIDERED = "sysvinit"

VIRTUAL-RUNTIME_initscripts = ""
```

## conf/layer.conf
```bitbake
# We have a conf and classes directory, add to BBPATH
BBPATH .= ":${LAYERDIR}"

# We have recipes-* directories, add to BBFILES
BBFILES += "${LAYERDIR}/recipes-*/*/*.bb \
	${LAYERDIR}/recipes-*/*/*.bbappend"

BBFILE_COLLECTIONS += "nanopi"
BBFILE_PATTERN_nanopi = "^${LAYERDIR}/"
BBFILE_PRIORITY_nanopi = "11"
LAYERDEPENDS_nanopi = "meta-sunxi swupdate qt5-layer"
LAYERVERSION_nanopi = "1"
```

## conf/machine/nanopi-m1-plus.conf
```bitbake
#@TYPE: Machine
#@NAME: nanopi M1 Plus
#@DESCRIPTION: Machine configuration for the FriendlyARM NanoPi Neo, based on the Allwinner H3 CPU

require conf/machine/include/sun8i.inc
require conf/machine/include/nanopi-m1-plus-default-providers.inc

PREFERRED_VERSION_u-boot = "v2017.11%"

KERNEL_DEVICETREE = "sun8i-h3-nanopi-m1-plus.dtb"
UBOOT_MACHINE = "nanopi_m1_plus_defconfig"

DEFAULTTUNE = "cortexa7hf-neon-vfpv4"

MACHINE_FEATURES = "alsa apm keyboard rtc serial screen usbgadget usbhost vfat bluetooth wifi"
```

## conf/machine/nanopi-neo-m1-plus.conf
```bitbake
#@TYPE: Machine
#@NAME: nanopi-neo M1 Plus
#@DESCRIPTION: Machine configuration for the FriendlyARM NanoPi Neo, based on the Allwinner H3 CPU

require conf/machine/include/sun8i.inc

PREFERRED_VERSION_u-boot = "v2017.11%"
PREFERRED_VERSION_linux-mainline = "4.15+git%"

KERNEL_DEVICETREE = "sun8i-h3-nanopi-m1-plus.dtb"
UBOOT_MACHINE = "nanopi_m1_plus_defconfig"

DEFAULTTUNE = "cortexa7hf-neon-vfpv4"
```
